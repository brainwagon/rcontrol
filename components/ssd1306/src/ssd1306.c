#include "ssd1306.h"
#include "driver/i2c.h"
#include "esp_log.h"
#include <string.h>

#define TAG "SSD1306"

#define I2C_MASTER_NUM              0
#define I2C_MASTER_FREQ_HZ          400000
#define I2C_MASTER_TX_BUF_DISABLE   0
#define I2C_MASTER_RX_BUF_DISABLE   0
#define I2C_MASTER_TIMEOUT_MS       1000

#define SSD1306_I2C_ADDR            0x3C

// Commands
#define SSD1306_CMD_START           0x00
#define SSD1306_DATA_START          0x40

static uint8_t s_buffer[SSD1306_WIDTH * SSD1306_HEIGHT / 8];

// Simple 8x8 font (subset of ASCII)
// This is a minimal placeholder font for A-Z, 0-9, and some symbols.
// For a full production system, a complete font table should be used.
// 8 bytes per character. 
static const uint8_t font8x8_basic[96][8] = {
    {0x00, 0x00, 0x00, 0x00, 0x00, 0x00, 0x00, 0x00}, // space
    {0x00, 0x00, 0x5F, 0x00, 0x00, 0x00, 0x00, 0x00}, // !
    {0x00, 0x00, 0x07, 0x00, 0x07, 0x00, 0x00, 0x00}, // "
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    {0x00, 0x08, 0x04, 0x08, 0x04, 0x08, 0x00, 0x00}  // ~
};

static esp_err_t ssd1306_send_cmd(uint8_t cmd) {
    i2c_cmd_handle_t link = i2c_cmd_link_create();
    i2c_master_start(link);
    i2c_master_write_byte(link, (SSD1306_I2C_ADDR << 1) | I2C_MASTER_WRITE, true);
    i2c_master_write_byte(link, SSD1306_CMD_START, true);
    i2c_master_write_byte(link, cmd, true);
    i2c_master_stop(link);
    esp_err_t ret = i2c_master_cmd_begin(I2C_MASTER_NUM, link, pdMS_TO_TICKS(I2C_MASTER_TIMEOUT_MS));
    i2c_cmd_link_delete(link);
    return ret;
}

static esp_err_t ssd1306_send_data(const uint8_t *data, size_t len) {
    i2c_cmd_handle_t link = i2c_cmd_link_create();
    i2c_master_start(link);
    i2c_master_write_byte(link, (SSD1306_I2C_ADDR << 1) | I2C_MASTER_WRITE, true);
    i2c_master_write_byte(link, SSD1306_DATA_START, true);
    i2c_master_write(link, data, len, true);
    i2c_master_stop(link);
    esp_err_t ret = i2c_master_cmd_begin(I2C_MASTER_NUM, link, pdMS_TO_TICKS(I2C_MASTER_TIMEOUT_MS));
    i2c_cmd_link_delete(link);
    return ret;
}

esp_err_t ssd1306_init(void) {
    // Initialization Sequence
    ssd1306_send_cmd(0xAE); // Display Off
    ssd1306_send_cmd(0xD5); // Set Display Clock Divide Ratio
    ssd1306_send_cmd(0x80); // Suggested ratio
    ssd1306_send_cmd(0xA8); // Set Multiplex Ratio
    ssd1306_send_cmd(0x3F); // 64-1
    ssd1306_send_cmd(0xD3); // Set Display Offset
    ssd1306_send_cmd(0x00); // 0
    ssd1306_send_cmd(0x40); // Set Start Line | 0
    ssd1306_send_cmd(0x8D); // Charge Pump
    ssd1306_send_cmd(0x14); // Enable
    ssd1306_send_cmd(0x20); // Memory Mode
    ssd1306_send_cmd(0x00); // Horizontal
    ssd1306_send_cmd(0xA1); // Segment Remap 1
    ssd1306_send_cmd(0xC8); // Com Scan Dec
    ssd1306_send_cmd(0xDA); // Set COM Pins
    ssd1306_send_cmd(0x12);
    ssd1306_send_cmd(0x81); // Set Contrast
    ssd1306_send_cmd(0xCF);
    ssd1306_send_cmd(0xD9); // Set Precharge
    ssd1306_send_cmd(0xF1);
    ssd1306_send_cmd(0xDB); // Set VCOM Detect
    ssd1306_send_cmd(0x40);
    ssd1306_send_cmd(0xA4); // Resume to RAM content
    ssd1306_send_cmd(0xA6); // Normal Display
    ssd1306_send_cmd(0xAF); // Display On

    ssd1306_clear();
    ssd1306_update();
    
    ESP_LOGI(TAG, "SSD1306 Initialized");
    return ESP_OK;
}

void ssd1306_clear(void) {
    memset(s_buffer, 0, sizeof(s_buffer));
}

void ssd1306_draw_char(int x, int y, char c) {
    if (c < 32 || c > 126) return;
    if (x >= SSD1306_WIDTH || y >= SSD1306_HEIGHT) return;

    int font_idx = c - 32;
    // Buffer is 128 width, each byte is 8 vertical pixels (Page addressing in memory, but here we treat buffer as linear if we map correctly)
    // Actually, Horizontal Addressing Mode (set in init 0x20 0x00) advances pointer automatically.
    // We need to map (x,y) to the buffer.
    // SSD1306 Buffer mapping in Horizontal mode:
    // Pages 0-7 (8 pixels height each).
    // Page 0: Col 0...127
    // Page 1: Col 0...127
    // ...
    // So buffer index = (y / 8) * 128 + x.
    // The byte at that index represents 8 vertical pixels at that x, from y%8=0 to 7.
    // Our font is 8x8. So if y is aligned to 8 (0, 8, 16...), we just write one byte per column of the character.
    
    // We assume y is page aligned for text (0, 8, 16, 24...) for simplicity, or we do bit shifting.
    // The requirement is "8 lines", implying page alignment.
    
    int page = y / 8;
    if (page >= 8) return;
    
    for (int i = 0; i < 8; i++) {
        int col = x + i;
        if (col >= SSD1306_WIDTH) break;
        s_buffer[page * 128 + col] = font8x8_basic[font_idx][i];
    }
}

void ssd1306_draw_string(int x, int y, const char *text) {
    int cursor_x = x;
    int cursor_y = y;
    while (*text) {
        if (*text == '\n') {
            cursor_y += 8;
            cursor_x = x;
        } else {
            ssd1306_draw_char(cursor_x, cursor_y, *text);
            cursor_x += 8;
            if (cursor_x >= SSD1306_WIDTH) {
                cursor_x = x;
                cursor_y += 8;
            }
        }
        text++;
    }
}

void ssd1306_update(void) {
    // Write full buffer
    // In Horizontal addressing mode, we just write all bytes.
    // Set column address 0-127
    ssd1306_send_cmd(0x21); 
    ssd1306_send_cmd(0); 
    ssd1306_send_cmd(127);
    // Set page address 0-7
    ssd1306_send_cmd(0x22); 
    ssd1306_send_cmd(0); 
    ssd1306_send_cmd(7);
    
    ssd1306_send_data(s_buffer, sizeof(s_buffer));
}
