## main/Kconfig.projbuild
```kconfig
menu "Display Configuration"

    menu "SSD1306 (I2C) Configuration"
        config ENABLE_SSD1306
            bool "Enable SSD1306 OLED Display"
            default y
            help
                Enable support for SSD1306 0.96" I2C OLED modules.
    endmenu

    menu "ST7735 (SPI) Configuration"
        config ENABLE_ST7735
            bool "Enable ST7735 TFT Display"
            default n
            help
                Enable support for ST7735 1.8" SPI TFT modules.

        choice ST7735_COUNT
            prompt "Number of ST7735 Instances"
            depends on ENABLE_ST7735
            default ST7735_COUNT_1

            config ST7735_COUNT_1
                bool "1 Display"
            config ST7735_COUNT_2
                bool "2 Displays"
        endchoice

        config ST7735_NUM_DEVS
            int
            default 1 if ST7735_COUNT_1
            default 2 if ST7735_COUNT_2
            default 0

        config ST7735_SPI_HOST
            int "SPI Host ID (1=SPI2/HSPI, 2=SPI3/VSPI)"
            depends on ENABLE_ST7735
            default 2
            range 1 2

        config ST7735_PIN_SCLK
            int "SCLK Pin"
            depends on ENABLE_ST7735
            default 18

        config ST7735_PIN_MOSI
            int "MOSI Pin"
            depends on ENABLE_ST7735
            default 23

        config ST7735_PIN_DC
            int "DC (Data/Command) Pin"
            depends on ENABLE_ST7735
            default 17

        config ST7735_PIN_RST
            int "RST (Reset) Pin"
            depends on ENABLE_ST7735
            default 16

        config ST7735_PIN_CS1
            int "CS Pin (Display 1)"
            depends on ENABLE_ST7735
            default 5

        config ST7735_PIN_CS2
            int "CS Pin (Display 2)"
            depends on ENABLE_ST7735 && ST7735_COUNT_2
            default 4
    endmenu

    menu "IMU Configuration"
        config ENABLE_MPU6050
            bool "Enable MPU6050 (I2C)"
            default n
            help
                Enable support for MPU6050 6-axis IMU.

        config MPU6050_I2C_ADDR
            hex "MPU6050 I2C Address"
            depends on ENABLE_MPU6050
            default 0x68
            help
                I2C Address of the MPU6050 (usually 0x68 or 0x69).
    endmenu

endmenu
```

## sdkconfig.defaults
```kconfig
CONFIG_BT_ENABLED=y
CONFIG_BT_CLASSIC_ENABLED=y
CONFIG_BT_BLE_ENABLED=y
CONFIG_BTDM_CTRL_MODE_BTDM=y
CONFIG_BTDM_CTRL_MODE_BLE_ONLY=n
CONFIG_BTDM_CTRL_MODE_BR_EDR_ONLY=n
CONFIG_BT_BLUEDROID_ENABLED=y
CONFIG_BT_SPP_ENABLED=y
CONFIG_BT_L2CAP_ENABLED=y
CONFIG_ESP_HID_HOST_ENABLED=y
CONFIG_BT_HID_ENABLED=y
CONFIG_BT_HID_HOST_ENABLED=y
CONFIG_BT_GATTC_ENABLE=y
CONFIG_BT_GATTS_ENABLE=y
CONFIG_GATTC_ENABLE=y
CONFIG_GATTS_ENABLE=y
CONFIG_BT_NIMBLE_ENABLED=n
CONFIG_I2C_SUPPRESS_DEPRECATE_WARN=y
```
