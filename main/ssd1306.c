#include "ssd1306.h"
#include <string.h>
#include <stdlib.h>
#include "esp_log.h"

#define TAG "SSD1306"

#define SSD1306_WIDTH 128
#define SSD1306_HEIGHT 64

// Control bytes
#define OLED_CONTROL_BYTE_CMD_STREAM    0x00
#define OLED_CONTROL_BYTE_CMD_SINGLE    0x80
#define OLED_CONTROL_BYTE_DATA_STREAM   0x40

// Simple 5x7 Font (ASCII 32-127) - Minimal subset for example
// A full font takes space, I'll include a basic one.
static const uint8_t font5x7[][5] = {
    {0x00, 0x00, 0x00, 0x00, 0x00}, // space
    {0x00, 0x00, 0x5F, 0x00, 0x00}, // !
    {0x00, 0x07, 0x00, 0x07, 0x00}, // "
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    {0x10, 0x08, 0x08, 0x10, 0x08}  // ~
};


typedef struct {
    i2c_port_t port;
    uint8_t addr;
    uint8_t buffer[1024]; // 128 * 64 / 8
} ssd1306_dev_t;

ssd1306_handle_t ssd1306_create(i2c_port_t port, uint8_t addr) {
    ssd1306_dev_t *dev = malloc(sizeof(ssd1306_dev_t));
    dev->port = port;
    dev->addr = addr;
    memset(dev->buffer, 0, sizeof(dev->buffer));
    return (ssd1306_handle_t)dev;
}

static void i2c_write_cmd(ssd1306_dev_t *dev, uint8_t command) {
    uint8_t data[2] = {0x00, command};
    i2c_master_write_to_device(dev->port, dev->addr, data, 2, 100/portTICK_PERIOD_MS);
}

void ssd1306_init(ssd1306_handle_t handle) {
    ssd1306_dev_t *dev = (ssd1306_dev_t *)handle;
    
    // Init Sequence
    i2c_write_cmd(dev, 0xAE); // Display Off
    i2c_write_cmd(dev, 0xD5); // Set Display Clock Divide Ratio/Oscillator Frequency
    i2c_write_cmd(dev, 0x80);
    i2c_write_cmd(dev, 0xA8); // Set Multiplex Ratio
    i2c_write_cmd(dev, 0x3F);
    i2c_write_cmd(dev, 0xD3); // Set Display Offset
    i2c_write_cmd(dev, 0x00);
    i2c_write_cmd(dev, 0x40); // Set Display Start Line
    i2c_write_cmd(dev, 0x8D); // Set Charge Pump
    i2c_write_cmd(dev, 0x14);
    i2c_write_cmd(dev, 0x20); // Set Memory Addressing Mode
    i2c_write_cmd(dev, 0x00); // Horizontal Addressing
    i2c_write_cmd(dev, 0xA1); // Set Segment Re-map
    i2c_write_cmd(dev, 0xC8); // Set COM Output Scan Direction
    i2c_write_cmd(dev, 0xDA); // Set COM Pins Hardware Configuration
    i2c_write_cmd(dev, 0x12);
    i2c_write_cmd(dev, 0x81); // Set Contrast Control
    i2c_write_cmd(dev, 0xCF);
    i2c_write_cmd(dev, 0xD9); // Set Pre-charge Period
    i2c_write_cmd(dev, 0xF1);
    i2c_write_cmd(dev, 0xDB); // Set VCOMH Deselect Level
    i2c_write_cmd(dev, 0x40);
    i2c_write_cmd(dev, 0xA4); // Entire Display ON (resume)
    i2c_write_cmd(dev, 0xA6); // Set Normal Display
    i2c_write_cmd(dev, 0xAF); // Display On
    
    ssd1306_clear(handle);
    ssd1306_refresh(handle);
}

void ssd1306_clear(ssd1306_handle_t handle) {
    ssd1306_dev_t *dev = (ssd1306_dev_t *)handle;
    memset(dev->buffer, 0, sizeof(dev->buffer));
}

void ssd1306_draw_char(ssd1306_dev_t *dev, int x, int y, char c) {
    if (x >= SSD1306_WIDTH || y >= SSD1306_HEIGHT) return;
    if (c < 32 || c > 127) c = '?';
    
    int font_idx = c - 32;
    // 5x7 font, height is 8 bits (1 page).
    // Simple drawing: 8 lines high means 1 byte per column.
    // Horizontal addressing mode makes this easy if y is multiple of 8.
    // For arbitrary y, we need bit manipulation.
    // Simplifying assumption: y is page index (0-7).
    
    // Actually, let's treat y as pixel coordinate but snap to pages for simplicity in this proto driver.
    int page = y / 8;
    int offset = x + (page * SSD1306_WIDTH);
    
    for (int i = 0; i < 5; i++) {
        if (x + i < SSD1306_WIDTH) {
             dev->buffer[offset + i] |= font5x7[font_idx][i];
        }
    }
}

void ssd1306_draw_string(ssd1306_handle_t handle, int x, int y, const char *text) {
    ssd1306_dev_t *dev = (ssd1306_dev_t *)handle;
    int cx = x;
    while (*text) {
        ssd1306_draw_char(dev, cx, y, *text);
        cx += 6; // 5 + 1 space
        text++;
    }
}

void ssd1306_refresh(ssd1306_handle_t handle) {
    ssd1306_dev_t *dev = (ssd1306_dev_t *)handle;
    
    i2c_write_cmd(dev, 0x21); // Set Column Address
    i2c_write_cmd(dev, 0);
    i2c_write_cmd(dev, 127);
    
    i2c_write_cmd(dev, 0x22); // Set Page Address
    i2c_write_cmd(dev, 0);
    i2c_write_cmd(dev, 7);
    
    // Write data in chunks
    // I2C max buffer is limited. We send 128 bytes (1 page) at a time?
    // 1024 bytes total.
    
    for (int i = 0; i < 1024; i += 16) {
        uint8_t data[17];
        data[0] = 0x40; // Data stream
        memcpy(&data[1], &dev->buffer[i], 16);
        i2c_master_write_to_device(dev->port, dev->addr, data, 17, 100/portTICK_PERIOD_MS);
    }
}
